/**
 * @cliArgs --device "F2838x" --part "F2838x_337bga" --package "337bga" --context "CPU2" --product "C2000WARE@5.04.00.00"
 * @versions {"tool":"1.27.1+4634"}
 */

/**
 * Import the modules used in this configuration.
 */
const cputimer  = scripting.addModule("/driverlib/cputimer.js", {}, false);
const cputimer1 = cputimer.addInstance();
const flash     = scripting.addModule("/driverlib/flash.js", {}, false);
const flash1    = flash.addInstance();
const ipc       = scripting.addModule("/driverlib/ipc.js");

/**
 * Write custom configuration values to the imported modules.
 */
cputimer1.$name          = "SWTIRMER";
cputimer1.cputimerBase   = "CPUTIMER1_BASE";
cputimer1.emulationMode  = "CPUTIMER_EMULATIONMODE_RUNFREE";
cputimer1.timerPrescaler = 3;
cputimer1.timerPeriod    = 50000000;
cputimer1.startTimer     = true;

flash1.$name = "FMC_CPU2";

ipc.ipcRegisterFlag = ["IPC_FLAG31"];
ipc.flagHandler31   = "IPC_SYNC";
